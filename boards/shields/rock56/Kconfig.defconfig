## boards/shields/rock56/Kconfig.defconfig
```kconfig
if SHIELD_ROCK56_LEFT

config ZMK_KEYBOARD_NAME
    default "rock56"

config ZMK_SPLIT_BLE_ROLE_CENTRAL
    default y

endif

if SHIELD_ROCK56_LEFT || SHIELD_ROCK56_RIGHT

config ZMK_SPLIT
    default y

endif
```

## boards/shields/rock56/Kconfig.shield
```kconfig
# Copyright (c) 2020 Pete Johanson
# SPDX-License-Identifier: MIT

config SHIELD_ROCK56_LEFT
    def_bool $(shields_list_contains,rock56_left)

config SHIELD_ROCK56_RIGHT
    def_bool $(shields_list_contains,rock56_right)
```
